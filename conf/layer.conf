## conf/layer.conf
```bitbake
# We have a conf and classes directory, append to BBPATH
BBPATH .= ":${LAYERDIR}"

# We have a recipes directory, add to BBFILES
BBFILES += "${LAYERDIR}/recipes-*/*/*.bb ${LAYERDIR}/recipes-*/*/*.bbappend"

BBFILE_COLLECTIONS += "imx-demo"
BBFILE_PATTERN_imx-demo := "^${LAYERDIR}/"
BBFILE_PRIORITY_imx-demo = "7"

LAYERSERIES_COMPAT_imx-demo = "sumo thud warrior zeus gatesgarth hardknott honister kirkstone langdale mickledore nanbield scarthgap styhead walnascar"

GPNT_APPS_FOLDER ?= "/opt/gopoint-apps"
```
